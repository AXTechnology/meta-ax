## conf/machine/triplex.conf
```bitbake
#@TYPE: Machine
#@NAME: AX triplex
#@DESCRIPTION: Machine configuration for the triplex

MKUBIFS_ARGS = "-m 2048 -e 126976 -c 8192"
UBINIZE_ARGS = "-m 2048 -p 128KiB"

MACHINE_FEATURES += "textlcd dvb-c"

IMAGE_FSTYPES ?= "ubi tar.gz"

CHIPSET = "bcm7356"
RCTYPE = "UNKNOWN"

require conf/machine/include/ax.inc
```
